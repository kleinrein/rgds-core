## os/buildroot/Config.in
```kconfig
menu "RG DS OS"
source "$BR2_EXTERNAL_RGDS_PATH/package/rgds-core/Config.in"
source "$BR2_EXTERNAL_RGDS_PATH/package/rgds-music/Config.in"
source "$BR2_EXTERNAL_RGDS_PATH/package/rgds-media/Config.in"
source "$BR2_EXTERNAL_RGDS_PATH/package/rgds-pad/Config.in"
source "$BR2_EXTERNAL_RGDS_PATH/package/libudev-zero/Config.in"
source "$BR2_EXTERNAL_RGDS_PATH/package/libldac/Config.in"
source "$BR2_EXTERNAL_RGDS_PATH/package/mesa3d-panfrost/Config.in"
source "$BR2_EXTERNAL_RGDS_PATH/package/libretro-fceumm/Config.in"
source "$BR2_EXTERNAL_RGDS_PATH/package/libretro-snes9x/Config.in"
source "$BR2_EXTERNAL_RGDS_PATH/package/libretro-picodrive/Config.in"
source "$BR2_EXTERNAL_RGDS_PATH/package/libretro-pcsx-rearmed/Config.in"
source "$BR2_EXTERNAL_RGDS_PATH/package/libretro-mupen64plus-next/Config.in"
source "$BR2_EXTERNAL_RGDS_PATH/package/libretro-fuse/Config.in"
source "$BR2_EXTERNAL_RGDS_PATH/package/libretro-vice/Config.in"
source "$BR2_EXTERNAL_RGDS_PATH/package/libretro-gw/Config.in"
source "$BR2_EXTERNAL_RGDS_PATH/package/libretro-scummvm/Config.in"
source "$BR2_EXTERNAL_RGDS_PATH/package/libretro-ppsspp/Config.in"
source "$BR2_EXTERNAL_RGDS_PATH/package/libretro-flycast/Config.in"
source "$BR2_EXTERNAL_RGDS_PATH/package/libretro-gearcoleco/Config.in"
source "$BR2_EXTERNAL_RGDS_PATH/package/libretro-freeintv/Config.in"
source "$BR2_EXTERNAL_RGDS_PATH/package/libretro-bluemsx/Config.in"
source "$BR2_EXTERNAL_RGDS_PATH/package/libretro-cap32/Config.in"
source "$BR2_EXTERNAL_RGDS_PATH/package/libretro-mame2003-plus/Config.in"
source "$BR2_EXTERNAL_RGDS_PATH/package/libretro-fbneo/Config.in"
source "$BR2_EXTERNAL_RGDS_PATH/package/libretro-beetle-pce-fast/Config.in"
source "$BR2_EXTERNAL_RGDS_PATH/package/libretro-stella2014/Config.in"
source "$BR2_EXTERNAL_RGDS_PATH/package/libretro-prosystem/Config.in"
source "$BR2_EXTERNAL_RGDS_PATH/package/libretro-a5200/Config.in"
source "$BR2_EXTERNAL_RGDS_PATH/package/libretro-handy/Config.in"
source "$BR2_EXTERNAL_RGDS_PATH/package/libretro-beetle-wswan/Config.in"
source "$BR2_EXTERNAL_RGDS_PATH/package/libretro-beetle-ngp/Config.in"
source "$BR2_EXTERNAL_RGDS_PATH/package/libretro-beetle-vb/Config.in"
source "$BR2_EXTERNAL_RGDS_PATH/package/libretro-puae/Config.in"
source "$BR2_EXTERNAL_RGDS_PATH/package/libretro-dosbox-pure/Config.in"
source "$BR2_EXTERNAL_RGDS_PATH/package/libretro-fake08/Config.in"
source "$BR2_EXTERNAL_RGDS_PATH/package/libretro-ruffle/Config.in"
source "$BR2_EXTERNAL_RGDS_PATH/package/rocknix-extra-firmware/Config.in"
endmenu
```

## os/buildroot/package/libldac/Config.in
```kconfig
config BR2_PACKAGE_LIBLDAC
	bool "libldac"
	depends on BR2_PACKAGE_BLUEZ_ALSA
	help
	  AOSP's LDAC encoder (libldacBT_enc, Apache-2.0) with its adaptive bit rate helper (libldacBT_abr), as
	  EHfive/ldacBT builds them. With it bluez-alsa sends LDAC to headphones that take it (this package's .mk
	  adds --enable-ldac to bluez-alsa). Encoder only: AOSP ships no LDAC decoder.
	  https://github.com/EHfive/ldacBT
```

## os/buildroot/package/libretro-a5200/Config.in
```kconfig
config BR2_PACKAGE_LIBRETRO_A5200
	bool "libretro-a5200"
	depends on BR2_INSTALL_LIBSTDCPP
	help
	  a5200, the Atari 5200 core RG DS Play loads for .a52 games (and .bin in
	  an Atari 5200 folder): /usr/lib/libretro/a5200_libretro.so. The owner's
	  5200.rom when present, else the free Altirra OS the core carries. Patch
	  0001 takes the keypad drawn on the touch screen.
```

## os/buildroot/package/libretro-beetle-ngp/Config.in
```kconfig
config BR2_PACKAGE_LIBRETRO_BEETLE_NGP
	bool "libretro-beetle-ngp"
	depends on BR2_INSTALL_LIBSTDCPP
	help
	  Beetle NeoPop (Mednafen), the Neo Geo Pocket and Pocket Color core
	  RG DS Play loads for .ngp and .ngc games:
	  /usr/lib/libretro/mednafen_ngp_libretro.so. No BIOS (the core's
	  own start-up), the console's language set to English.
```

## os/buildroot/package/libretro-beetle-pce-fast/Config.in
```kconfig
config BR2_PACKAGE_LIBRETRO_BEETLE_PCE_FAST
	bool "libretro-beetle-pce-fast"
	depends on BR2_INSTALL_LIBSTDCPP
	help
	  Beetle PCE Fast (Mednafen), the PC Engine / TurboGrafx-16 core RG DS
	  Play loads for .pce cards and CD-ROM discs:
	  /usr/lib/libretro/mednafen_pce_fast_libretro.so. Cards need no BIOS;
	  discs need the owner's syscard3.pce in the BIOS folder.
```

## os/buildroot/package/libretro-beetle-vb/Config.in
```kconfig
config BR2_PACKAGE_LIBRETRO_BEETLE_VB
	bool "libretro-beetle-vb"
	depends on BR2_INSTALL_LIBSTDCPP
	help
	  Beetle VB (Mednafen), the Virtual Boy core RG DS Play loads for .vb
	  and .vboy games (and .bin in a Virtual Boy folder):
	  /usr/lib/libretro/mednafen_vb_libretro.so. Red on black on the
	  upper screen, or one eye on each screen; no BIOS.
```

## os/buildroot/package/libretro-beetle-wswan/Config.in
```kconfig
config BR2_PACKAGE_LIBRETRO_BEETLE_WSWAN
	bool "libretro-beetle-wswan"
	depends on BR2_INSTALL_LIBSTDCPP
	help
	  Beetle WonderSwan (Mednafen), the WonderSwan and WonderSwan Color
	  core RG DS Play loads for .ws, .wsc and .pc2 games:
	  /usr/lib/libretro/mednafen_wswan_libretro.so. No BIOS; games made
	  to be held upright are turned by the core.
```

## os/buildroot/package/libretro-bluemsx/Config.in
```kconfig
config BR2_PACKAGE_LIBRETRO_BLUEMSX
	bool "libretro-bluemsx"
	help
	  blueMSX, the MSX and MSX2 core RG DS Play loads for .rom, .mx1, .mx2,
	  .dsk and .cas games: /usr/lib/libretro/bluemsx_libretro.so. The image
	  carries only the free C-BIOS machines and the game databases
	  (/usr/share/libretro/bluemsx, copied into the BIOS folder when an MSX
	  game starts): cartridges run on C-BIOS, disks and tapes need the
	  owner's own MSX BIOS machines there.
```

## os/buildroot/package/libretro-cap32/Config.in
```kconfig
config BR2_PACKAGE_LIBRETRO_CAP32
	bool "libretro-cap32"
	help
	  Caprice32, the Amstrad CPC core RG DS Play loads for .dsk, .sna and
	  .m3u games in a CPC folder and .cdt tapes and .cpr Plus cartridges
	  anywhere: /usr/lib/libretro/cap32_libretro.so. It carries the CPC's
	  own ROMs, so no BIOS is needed.
```

## os/buildroot/package/libretro-dosbox-pure/Config.in
```kconfig
config BR2_PACKAGE_LIBRETRO_DOSBOX_PURE
	bool "libretro-dosbox-pure"
	depends on BR2_INSTALL_LIBSTDCPP
	help
	  DOSBox Pure, the MS-DOS core RG DS Play loads for DOS games:
	  /usr/lib/libretro/dosbox_pure_libretro.so. It opens a game's ZIP
	  itself (and keeps the game's own saves beside it in a ZIP of
	  changes), mounts CD and floppy images, and has a mouse, which the
	  second screen's touch pad moves. No BIOS needed.
```

## os/buildroot/package/libretro-fake08/Config.in
```kconfig
config BR2_PACKAGE_LIBRETRO_FAKE08
	bool "libretro-fake08"
	depends on BR2_INSTALL_LIBSTDCPP
	help
	  fake-08, a free PICO-8 player (MIT; an independent re-creation, not
	  Lexaloffle's): /usr/lib/libretro/fake08_libretro.so, loaded by RG DS
	  Play for .p8 and .p8.png carts.
```

## os/buildroot/package/libretro-fbneo/Config.in
```kconfig
config BR2_PACKAGE_LIBRETRO_FBNEO
	bool "libretro-fbneo"
	help
	  FinalBurn Neo, the arcade core RG DS Play loads for every set in /data/roms/arcade but the two-monitor
	  cabinets' (libretro-mame2003-plus): /usr/lib/libretro/fbneo_libretro.so. Sets and board BIOS sets
	  (neogeo.zip) are the owner's own, named as FBNeo's DAT names them.
```

## os/buildroot/package/libretro-flycast/Config.in
```kconfig
config BR2_PACKAGE_LIBRETRO_FLYCAST
	bool "libretro-flycast"
	help
	  Flycast, the Dreamcast core RG DS Play loads for .gdi, .cdi and .chd discs:
	  /usr/lib/libretro/flycast_libretro.so. The owner's BIOS (dc_boot.bin,
	  dc_flash.bin) goes in /data/rgds/bios/dc; without it Flycast's own HLE BIOS
	  boots the game.
```

## os/buildroot/package/libretro-freeintv/Config.in
```kconfig
config BR2_PACKAGE_LIBRETRO_FREEINTV
	bool "libretro-freeintv"
	help
	  FreeIntv, the Intellivision core RG DS Play loads for .int games:
	  /usr/lib/libretro/freeintv_libretro.so. It needs the owner's exec.bin
	  and grom.bin in the BIOS folder. 0001 lets the player press the
	  controller's keypad from the touch screen.
```

## os/buildroot/package/libretro-gearcoleco/Config.in
```kconfig
config BR2_PACKAGE_LIBRETRO_GEARCOLECO
	bool "libretro-gearcoleco"
	depends on BR2_INSTALL_LIBSTDCPP
	help
	  Gearcoleco, the ColecoVision core RG DS Play loads for .col games:
	  /usr/lib/libretro/gearcoleco_libretro.so. It needs the owner's
	  colecovision.rom in the BIOS folder. 0001 lets the player press the
	  controller's keypad from the touch screen.
```

## os/buildroot/package/libretro-handy/Config.in
```kconfig
config BR2_PACKAGE_LIBRETRO_HANDY
	bool "libretro-handy"
	depends on BR2_INSTALL_LIBSTDCPP
	help
	  Handy, the Atari Lynx core RG DS Play loads for .lnx games:
	  /usr/lib/libretro/handy_libretro.so. Turns upright games itself; the
	  owner's lynxboot.img when present, else its own start-up.
```

## os/buildroot/package/libretro-mame2003-plus/Config.in
```kconfig
config BR2_PACKAGE_LIBRETRO_MAME2003_PLUS
	bool "libretro-mame2003-plus"
	help
	  mame2003-plus built with only Nintendo's two-monitor cabinets
	  (Punch-Out!!, Super Punch-Out!!, Arm Wrestling and the Vs. dual
	  system's games), which RG DS Play shows one monitor per screen:
	  /usr/lib/libretro/mame2003_plus_libretro.so, a few megabytes rather
	  than the whole core's forty. The sets are the owner's own, in
	  /data/roms/arcade.
```

## os/buildroot/package/libretro-picodrive/Config.in
```kconfig
config BR2_PACKAGE_LIBRETRO_PICODRIVE
	bool "libretro-picodrive"
	help
	  PicoDrive, the Mega Drive, 32X, Mega-CD, Pico, Master System, Game Gear
	  and SG-1000 core: /usr/lib/libretro/picodrive_libretro.so. 0001 puts the
	  Pico's pen and storyware page on the touch screen.
```

## os/buildroot/package/libretro-prosystem/Config.in
```kconfig
config BR2_PACKAGE_LIBRETRO_PROSYSTEM
	bool "libretro-prosystem"
	depends on BR2_INSTALL_LIBSTDCPP
	help
	  ProSystem, the Atari 7800 core RG DS Play loads for .a78 games (and
	  .bin in an Atari 7800 folder): /usr/lib/libretro/prosystem_libretro.so.
	  The 7800 BIOS is optional ("7800 BIOS (U).rom" in the BIOS folder).
```

## os/buildroot/package/libretro-puae/Config.in
```kconfig
config BR2_PACKAGE_LIBRETRO_PUAE
	bool "libretro-puae"
	help
	  PUAE, the Commodore Amiga core RG DS Play loads for .adf, .ipf, .hdf,
	  .lha (WHDLoad) and .uae games: /usr/lib/libretro/puae_libretro.so.
	  It starts on AROS, the free Kickstart replacement it carries, unless
	  the owner puts their own Kickstart ROMs in the BIOS folder (WHDLoad
	  and many games need those).
```

## os/buildroot/package/libretro-ruffle/Config.in
```kconfig
config BR2_PACKAGE_LIBRETRO_RUFFLE
	bool "libretro-ruffle"
	depends on BR2_aarch64
	help
	  Flash games: Ruffle (ruffle.rs, MIT/Apache-2.0) as the libretro
	  core RG DS Play loads for .swf movies and Flashpoint game packs,
	  /usr/lib/libretro/ruffle_libretro.so. Built from this
	  repository's play/ruffle by tools/build_ruffle.py on the build
	  machine (Buildroot's Rust is too old for Ruffle 0.8.0); this
	  package installs the result. Draws with GLES through Mesa's EGL.
```

## os/buildroot/package/libretro-stella2014/Config.in
```kconfig
config BR2_PACKAGE_LIBRETRO_STELLA2014
	bool "libretro-stella2014"
	depends on BR2_INSTALL_LIBSTDCPP
	help
	  Stella 2014, the Atari 2600 core RG DS Play loads for .a26 games
	  (and .bin in an Atari folder): /usr/lib/libretro/stella2014_libretro.so.
	  The console's switches are on the touch screen; no BIOS.
```

## os/buildroot/package/rgds-media/Config.in
```kconfig
config BR2_PACKAGE_RGDS_MEDIA
	bool "rgds-media"
	depends on BR2_INSTALL_LIBSTDCPP
	depends on BR2_TOOLCHAIN_HAS_SYNC_4 # harfbuzz (libass, mupdf)
	depends on BR2_TOOLCHAIN_GCC_AT_LEAST_4_9 # harfbuzz
	select BR2_PACKAGE_FFMPEG
	select BR2_PACKAGE_FFMPEG_SWSCALE
	select BR2_PACKAGE_LIBASS
	select BR2_PACKAGE_MUPDF
	select BR2_PACKAGE_SDL2
	select BR2_PACKAGE_ZLIB
	help
	  RG DS Media (play/src/media, docs/MEDIA_PLAN.md): films and books on both screens, /usr/bin/rgds-media,
	  started from Home's Media tile by runtime/media.py. FFmpeg plays the films (libass draws their
	  subtitles), MuPDF opens PDF, EPUB, CBZ and the rest. Built against the image's own libraries, as the music
	  engine is.
```

## os/buildroot/package/rgds-music/Config.in
```kconfig
config BR2_PACKAGE_RGDS_MUSIC
	bool "rgds-music"
	depends on BR2_INSTALL_LIBSTDCPP
	select BR2_PACKAGE_FFMPEG
	select BR2_PACKAGE_FFMPEG_SWSCALE
	select BR2_PACKAGE_SDL2
	help
	  The music player's engine (src/music/engine.cpp): /usr/bin/rgds-music, which RG DS Core's launcher
	  starts when Settings > Sound > Music player is on. Built here, against the image's own FFmpeg, rather
	  than with the launcher: FFmpeg's structures differ between versions, so the engine is compiled against
	  the headers of the library it will load. Tracker modules play when BR2_PACKAGE_LIBOPENMPT is on.
```
