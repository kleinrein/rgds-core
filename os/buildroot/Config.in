## os/buildroot/Config.in
```kconfig
menu "RG DS OS"
source "$BR2_EXTERNAL_RGDS_PATH/package/rgds-core/Config.in"
source "$BR2_EXTERNAL_RGDS_PATH/package/libudev-zero/Config.in"
source "$BR2_EXTERNAL_RGDS_PATH/package/mesa3d-panfrost/Config.in"
source "$BR2_EXTERNAL_RGDS_PATH/package/libretro-fceumm/Config.in"
source "$BR2_EXTERNAL_RGDS_PATH/package/libretro-snes9x/Config.in"
source "$BR2_EXTERNAL_RGDS_PATH/package/libretro-picodrive/Config.in"
source "$BR2_EXTERNAL_RGDS_PATH/package/libretro-pcsx-rearmed/Config.in"
source "$BR2_EXTERNAL_RGDS_PATH/package/libretro-mupen64plus-next/Config.in"
endmenu
```

## os/buildroot/package/libretro-fake08/Config.in
```kconfig
config BR2_PACKAGE_LIBRETRO_FAKE08
	bool "libretro-fake08"
	help
	  fake-08, a PICO-8 player (MIT): /usr/lib/libretro/fake08_libretro.so, loaded by RG DS Play for .p8 carts.
```

## os/buildroot/package/libretro-fceumm/Config.in
```kconfig
config BR2_PACKAGE_LIBRETRO_FCEUMM
	bool "libretro-fceumm"
	help
	  FCEUmm, the NES core (GPL-2.0): /usr/lib/libretro/fceumm_libretro.so, loaded by RG DS Play.
```

## os/buildroot/package/libretro-fuse/Config.in
```kconfig
config BR2_PACKAGE_LIBRETRO_FUSE
	bool "libretro-fuse"
	help
	  Fuse, the ZX Spectrum core RG DS Play loads for .tzx, .tap, .z80 and .sna games:
	  /usr/lib/libretro/fuse_libretro.so. The Spectrum's ROMs are built in.
```

## os/buildroot/package/libretro-gw/Config.in
```kconfig
config BR2_PACKAGE_LIBRETRO_GW
	bool "libretro-gw"
	help
	  gw-libretro, which runs MADrigal's Game & Watch and LCD game simulators (.mgw) for RG DS Play:
	  /usr/lib/libretro/gw_libretro.so. The simulators are the owner's own, in /data/roms/gw.
```

## os/buildroot/package/libretro-mupen64plus-next/Config.in
```kconfig
config BR2_PACKAGE_LIBRETRO_MUPEN64PLUS_NEXT
	bool "libretro-mupen64plus-next"
	depends on BR2_PACKAGE_MESA3D_PANFROST
	help
	  Mupen64Plus-Next, the Nintendo 64 core (GPL-2.0) with the GLideN64 renderer on GLES 3:
	  /usr/lib/libretro/mupen64plus_next_libretro.so, loaded by RG DS Play, which gives it a GL context.
```

## os/buildroot/package/libretro-pcsx-rearmed/Config.in
```kconfig
config BR2_PACKAGE_LIBRETRO_PCSX_REARMED
	bool "libretro-pcsx-rearmed"
	help
	  PCSX ReARMed, the PlayStation core (GPL-2.0; its BIOS files are the owner's, in /data/rgds/bios):
	  /usr/lib/libretro/pcsx_rearmed_libretro.so, loaded by RG DS Play.
```

## os/buildroot/package/libretro-picodrive/Config.in
```kconfig
config BR2_PACKAGE_LIBRETRO_PICODRIVE
	bool "libretro-picodrive"
	help
	  PicoDrive, the Mega Drive, Master System and Game Gear core: /usr/lib/libretro/picodrive_libretro.so.
```

## os/buildroot/package/libretro-ppsspp/Config.in
```kconfig
config BR2_PACKAGE_LIBRETRO_PPSSPP
	bool "libretro-ppsspp"
	help
	  PPSSPP, the PlayStation Portable core RG DS Play loads for .iso and .cso games:
	  /usr/lib/libretro/ppsspp_libretro.so, with its assets (fonts and compatibility lists; no Sony files are
	  needed) in /usr/share/libretro/PPSSPP.
```

## os/buildroot/package/libretro-scummvm/Config.in
```kconfig
config BR2_PACKAGE_LIBRETRO_SCUMMVM
	bool "libretro-scummvm"
	help
	  ScummVM's libretro core with its lite set of engines, for RG DS Play's adventure games in /data/roms/scummvm:
	  /usr/lib/libretro/scummvm_libretro.so, its themes and engine data in /usr/share/libretro/scummvm.
```

## os/buildroot/package/libretro-snes9x/Config.in
```kconfig
config BR2_PACKAGE_LIBRETRO_SNES9X
	bool "libretro-snes9x"
	help
	  Snes9x, the Super Nintendo core (non-commercial licence): /usr/lib/libretro/snes9x_libretro.so.
```

## os/buildroot/package/libretro-vice/Config.in
```kconfig
config BR2_PACKAGE_LIBRETRO_VICE
	bool "libretro-vice"
	help
	  VICE's fast C64 (x64), the Commodore 64 core RG DS Play loads for .d64, .t64, .crt and .prg games:
	  /usr/lib/libretro/vice_x64_libretro.so. The C64's ROMs are built in.
```

## os/buildroot/package/rgds-core/Config.in
```kconfig
config BR2_PACKAGE_RGDS_CORE
	bool "rgds-core"
	select BR2_PACKAGE_PYTHON3
	select BR2_PACKAGE_SDL2
	select BR2_PACKAGE_ALSA_UTILS
	select BR2_PACKAGE_ALSA_UTILS_AMIXER
	help
	  RG DS Core: the launcher, its runtime, themes and assets, and the emulators, as one release in
	  /usr/share/rgds/releases/<build> (named in /usr/share/rgds/active). tools/own_os_build.py stages
	  it (BR2_PACKAGE_RGDS_CORE_STAGE) from the repository's device build and a release package.

config BR2_PACKAGE_RGDS_CORE_STAGE
	string "staged release"
	depends on BR2_PACKAGE_RGDS_CORE
	default "$(BR2_EXTERNAL_RGDS_PATH)/../../build/os-stage/rgds-core"
```
